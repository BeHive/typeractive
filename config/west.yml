## config/west.yml
```yaml
manifest:
  remotes:
    - name: zmkfirmware
      url-base: https://github.com/zmkfirmware
    - name: BeHive                             # new entry
      url-base: https://github.com/BeHive      # new entry
  projects:
    - name: zmk
      remote: zmkfirmware
      revision: main
      import: app/west.yml
    - name: nice-view-battery                  # new entry
      remote: BeHive                           # new entry
      revision: main                           # new entry
  self:
    path: config
```
